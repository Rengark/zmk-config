## config/west.yml
```yaml
manifest:
  remotes:
    - name: Rengark
      url-base: https://github.com/Rengark
    # Additional modules containing boards/shields/custom code can be listed here as well
    # See https://docs.zephyrproject.org/3.2.0/develop/west/manifest.html#projects
  projects:
    - name: zmk-lily58-nv
      remote: Rengark
      revision: main
      # import: app/west.yml
  self:
    path: config
```
